## board/goembed/b6h_6ull/Kconfig
```kconfig
if TARGET_B6H_6ULL_14X14 || TARGET_MX6ULL_9X9_EVK

config SYS_BOARD
	default "b6h_6ull"

config SYS_VENDOR
	default "goembed"

config SYS_CONFIG_NAME
	default "b6h_6ull"

endif
```

## configs/b6h_6ull_14x14_evk_nand_defconfig
```kconfig
CONFIG_SYS_EXTRA_OPTIONS="IMX_CONFIG=board/goembed/b6h_6ull/imximage.cfg,SYS_BOOT_NAND,DDR_SIZE=256"
CONFIG_ARM=y
CONFIG_ARCH_MX6=y
CONFIG_TARGET_B6H_6ULL_14X14=y
CONFIG_CMD_GPIO=y
```
